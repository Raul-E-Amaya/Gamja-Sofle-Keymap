## config/west.yml
```yaml
manifest:
  remotes:
    - name: zmkfirmware
      url-base: https://github.com/zmkfirmware

    - name: Raul-E-Amaya
      url-base: https://github.com/Raul-E-Amaya

  projects:
    - name: zmk
      remote: zmkfirmware
      revision: main
      import: app/west.yml

    - name: nice-view-mod
      remote: Raul-E-Amaya
      revision: main

  self:
    path: config
```
